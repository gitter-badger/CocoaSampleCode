/*
	File:		MoreSCFHelpers.c

	Contains:	High-level System Configuration framework operations.

	Written by:	Quinn

	Copyright:	Copyright (c) 2001 by Apple Computer, Inc., All Rights Reserved.

	Disclaimer:	IMPORTANT:  This Apple software is supplied to you by Apple Computer, Inc.
				("Apple") in consideration of your agreement to the following terms, and your
				use, installation, modification or redistribution of this Apple software
				constitutes acceptance of these terms.  If you do not agree with these terms,
				please do not use, install, modify or redistribute this Apple software.

				In consideration of your agreement to abide by the following terms, and subject
				to these terms, Apple grants you a personal, non-exclusive license, under AppleÕs
				copyrights in this original Apple software (the "Apple Software"), to use,
				reproduce, modify and redistribute the Apple Software, with or without
				modifications, in source and/or binary forms; provided that if you redistribute
				the Apple Software in its entirety and without modifications, you must retain
				this notice and the following text and disclaimers in all such redistributions of
				the Apple Software.  Neither the name, trademarks, service marks or logos of
				Apple Computer, Inc. may be used to endorse or promote products derived from the
				Apple Software without specific prior written permission from Apple.  Except as
				expressly stated in this notice, no other rights or licenses, express or implied,
				are granted by Apple herein, including but not limited to any patent rights that
				may be infringed by your derivative works or by other works in which the Apple
				Software may be incorporated.

				The Apple Software is provided by Apple on an "AS IS" basis.  APPLE MAKES NO
				WARRANTIES, EXPRESS OR IMPLIED, INCLUDING WITHOUT LIMITATION THE IMPLIED
				WARRANTIES OF NON-INFRINGEMENT, MERCHANTABILITY AND FITNESS FOR A PARTICULAR
				PURPOSE, REGARDING THE APPLE SOFTWARE OR ITS USE AND OPERATION ALONE OR IN
				COMBINATION WITH YOUR PRODUCTS.

				IN NO EVENT SHALL APPLE BE LIABLE FOR ANY SPECIAL, INDIRECT, INCIDENTAL OR
				CONSEQUENTIAL DAMAGES (INCLUDING, BUT NOT LIMITED TO, PROCUREMENT OF SUBSTITUTE
				GOODS OR SERVICES; LOSS OF USE, DATA, OR PROFITS; OR BUSINESS INTERRUPTION)
				ARISING IN ANY WAY OUT OF THE USE, REPRODUCTION, MODIFICATION AND/OR DISTRIBUTION
				OF THE APPLE SOFTWARE, HOWEVER CAUSED AND WHETHER UNDER THEORY OF CONTRACT, TORT
				(INCLUDING NEGLIGENCE), STRICT LIABILITY OR OTHERWISE, EVEN IF APPLE HAS BEEN
				ADVISED OF THE POSSIBILITY OF SUCH DAMAGE.

	Change History (most recent first):

$Log: MoreSCFHelpers.c,v $
Revision 1.2  2002/01/22 06:22:50  eskimo1
Adapt to the new port scanner API.

Revision 1.1  2002/01/16 22:52:31  eskimo1
First checked in.


*/

/////////////////////////////////////////////////////////////////

// MoreIsBetter Setup

#include "MoreSetup.h"

// System interfaces

#include <SystemConfiguration/SystemConfiguration.h>

// MIB Interfaces

#include "MoreCFQ.h"
#include "MoreSCF.h"
#include "MoreSCFPortScanner.h"

// Our prototypes

#include "MoreSCFHelpers.h"

/////////////////////////////////////////////////////////////////
#pragma mark ***** AppleTalk On/Off

extern pascal OSStatus MoreSCIsAppleTalkActive(CFStringRef setID, Boolean *active)
	// See comment in header.
{
	OSStatus 	err;
	CFArrayRef	serviceIDs;
	
	MoreAssertQ(active != nil);
	
	*active = false;
	serviceIDs = nil;
	
	// Open a connection to SCF, get a list of all of the set's 
	// services, iterate through those services to see whether any 
	// of their AppleTalk entities are active.
	
	err = MoreSCOpen(false, false);
	if (err == noErr) {
		err = MoreSCCopyServiceIDs(setID, &serviceIDs, nil);
	}
	if (err == noErr) {
		CFIndex serviceCount;
		CFIndex serviceIndex;
		
		serviceCount = CFArrayGetCount(serviceIDs);
		serviceIndex = 0;
		while ( (err == noErr) && (serviceIndex < serviceCount) && !(*active) ) {
			CFStringRef thisService;
			Boolean		isActive;
			
			thisService = (CFStringRef) CFArrayGetValueAtIndex(serviceIDs, serviceIndex);
			err = MoreSCIsServiceActive(setID, thisService, &isActive);
			if (err == noErr && isActive) {
				err = MoreSCIsEntityActive(setID, thisService, kSCEntNetAppleTalk, &isActive);
				if (err == noErr && isActive) {
					*active = true;
				}			
			}
			serviceIndex += 1;
		}
	}
	MoreSCClose(&err, false);
	
	CFQRelease(serviceIDs);
	
	return err;
}

extern pascal OSStatus MoreSCSetAppleTalkActive(CFStringRef setID, Boolean active)
	// See comment in header.
{
	OSStatus 	err;
	CFArrayRef	serviceIDs;
	Boolean		madeChanges;
	
	serviceIDs = nil;

	// Open a connection to SCF, get a list of all of the set's 
	// services, iterate through those services to make their 
	// AppleTalk entities active.
		
	madeChanges = false;
	err = MoreSCOpen(false, false);
	if (err == noErr) {
		err = MoreSCCopyServiceIDs(setID, &serviceIDs, nil);
	}
	if (err == noErr) {
		CFIndex serviceCount;
		CFIndex serviceIndex;
		
		serviceCount = CFArrayGetCount(serviceIDs);
		for (serviceIndex = 0; serviceIndex < serviceCount; serviceIndex++) {
			CFStringRef 	thisService;
			Boolean			entityIsActive;

			thisService = (CFStringRef) CFArrayGetValueAtIndex(serviceIDs, serviceIndex);
			
			// There may be no AppleTalk entity in this service (for example, 
			// a PPP service), so we don't consider a failure to copy an error.
			
			if ( MoreSCIsEntityActive(setID, thisService, kSCEntNetAppleTalk, &entityIsActive) == noErr ) {
				if (entityIsActive != active) {
					err = MoreSCSetEntityActive(setID, thisService, kSCEntNetAppleTalk, active);
					if (err == noErr) {
						madeChanges = true;
					}
				}
			}
			
			if (err != noErr) {
				break;
			}
		}
	}
	MoreSCClose(&err, madeChanges);
	
	CFQRelease(serviceIDs);
	
	return err;
}

/////////////////////////////////////////////////////////////////
#pragma mark ***** DHCP Release

static OSStatus IsSetupConfiguredToUseDHCP(SCDynamicStoreRef storeRef, CFStringRef configuredIPv4Key, Boolean *isDHCP)
	// Given a path to an IPv4 entity within the Setup: domain of the 
	// dynamic store, sets *isDHCP to indicate whether the entity is 
	// configured to use DHCP address acquisition.
	//
	// The input string is something like "Setup:/Network/Service/<serviceID>/IPv4".
{
	OSStatus err;
	CFDictionaryRef value;
	CFStringRef configMethod;
	
	MoreAssertQ(storeRef != nil);
	MoreAssertQ(configuredIPv4Key != nil);
	MoreAssertQ(isDHCP != nil);
	
	value = nil;
	
	// Get the value of the IPv4 entity, extract the "ConfigMethod" 
	// property, and compare it to "DHCP".
	
	value = (CFDictionaryRef) SCDynamicStoreCopyValue(storeRef, configuredIPv4Key);
	err = MoreSCError( (void *) value );
	if (err == noErr) {
		MoreAssertQ( CFGetTypeID(value) == CFDictionaryGetTypeID() );
		if ( ! CFDictionaryGetValueIfPresent(value, kSCPropNetIPv4ConfigMethod, (const void **) &configMethod) ) {
			err = -2;
		}
	}
	if (err == noErr) {
		MoreAssertQ( CFGetTypeID(configMethod) == CFStringGetTypeID() );
		*isDHCP = CFEqual(configMethod, kSCValNetIPv4ConfigMethodDHCP);
	}

	// Clean up.
	
	CFQRelease(value);

	return err;
}

static OSStatus AppendServiceIDForEachDHCPDynamicStoreKey(SCDynamicStoreRef storeRef,
														  CFArrayRef configuredIPv4DynamicKeys, 
														  CFMutableArrayRef configuredDHCPServiceIDs)
	// Given an array of keys for configured IPv4 entities in the dynamic 
	// store, and a created mutable array of strings, this routine appends a 
	// service ID string to the output array for each element in 
	// the input array whoses ConfigMethod property is DHCP.
	//
	// Input array elements look like "Setup:/Network/Service/<serviceID>/IPv4".
	// Output array elements look like: "<serviceID>".
{
	OSStatus 	err;
	CFIndex		ipv4KeyCount;
	CFIndex 	keyIndex;

	MoreAssertQ(configuredIPv4DynamicKeys != nil);
	MoreAssertQ(configuredDHCPServiceIDs  != nil);
	
	// Iterate over each element in the input array.
	
	ipv4KeyCount = CFArrayGetCount(configuredIPv4DynamicKeys);

	err = noErr;
	for (keyIndex = 0; keyIndex < ipv4KeyCount; keyIndex++) {
		CFStringRef thisKey;			// got with "Get", so doesn't need to be released
		CFArrayRef	thisKeyExploded;
		Boolean		isDHCP;
		
		thisKeyExploded = nil;
		
		// Get the keyIndex'th array element and assert that it looks like a 
		// valid dynamic store key.
		
		thisKey = (CFStringRef) CFArrayGetValueAtIndex(configuredIPv4DynamicKeys, keyIndex);
		if (thisKey == nil) {
			err = coreFoundationUnknownErr;
		} else {
			MoreAssertQ( CFGetTypeID(thisKey) == CFStringGetTypeID() );
		}
		#if MORE_DEBUG
			if (err == noErr) {
				MoreAssertQ( CFStringHasPrefix(thisKey, CFSTR("Setup:/Network/Service/")) );
				MoreAssertQ( CFStringHasSuffix(thisKey, CFSTR("/IPv4")) );
			}
		#endif
		
		// Test to see whether we're interested in this element.

		if (err == noErr) {
			err = IsSetupConfiguredToUseDHCP(storeRef, thisKey, &isDHCP);
		}
		
		if (err == noErr && isDHCP) {
			// If we are, extract the service ID from the key and add it to 
			// the output array.
			
			// Explode the key into it's component pieces (separated by "/").  This is, IMHO, 
			// the easiest way to pull out the service ID part of the key (the "<serviceID>" in the 
			// examples at the beginning of this routine).
			
			if (err == noErr) {
				thisKeyExploded =  CFStringCreateArrayBySeparatingStrings(nil, thisKey, CFSTR("/"));
				if (thisKeyExploded == nil) {
					err = coreFoundationUnknownErr;
				}
			}

			// Add the service ID (the 3rd element of the exploded path) to the end of the results array.
			
			if (err == noErr) {
				MoreAssertQ( CFArrayGetCount(thisKeyExploded) == 5 );
				MoreAssertQ( CFGetTypeID(CFArrayGetValueAtIndex(thisKeyExploded, 3)) == CFStringGetTypeID() );

				CFArrayAppendValue(configuredDHCPServiceIDs, CFArrayGetValueAtIndex(thisKeyExploded, 3));
			}
		}
		
		// Clean up once each time around the loop.
		
		CFQRelease(thisKeyExploded);

		if (err != noErr) {
			break;
		}
	} // for
	
	return err;
}

extern pascal OSStatus MoreSCCreateActiveDHCPServicesArray(CFArrayRef *activeDHCP)
	// See comment in header.
{
	OSStatus 			err;
	CFStringRef 		dhcpPattern;
	CFArrayRef 			configuredIPv4DynamicKeys;
	CFMutableArrayRef 	result;
	SCDynamicStoreRef   storeRef;
		
	MoreAssertQ( activeDHCP != nil);
	MoreAssertQ(*activeDHCP == nil);
	
	dhcpPattern = nil;
	configuredIPv4DynamicKeys = nil;
	result = nil;

	// Open a connection to the dynamic store.
	
    storeRef = SCDynamicStoreCreate(nil, MoreSCGetClient(), nil, nil);
    err = MoreSCError( (void *) storeRef);
	if (err == noErr) {
		// Create dhcpPattern as "Setup:/Network/Service/[^/]+/IPv4".  
		// SCDynamicStoreKeyCreateNetworkServiceEntity provides both 
		// kSCCompNetwork ("Network") and kSCCompService ("Service").
		//
		// We work in the Setup: domain not the state domain because 
		// that's where we find the ConfigMethod = DHCP property.  We 
		// can't just search for DHCP entities (which is what I originally 
		// implemented) because, if the interface is configured to use DHCP 
		// but didn't find a server, it's assigned an autonet address 
		// (169.x.x.x) but no DHCP entity is created.
		
		dhcpPattern = SCDynamicStoreKeyCreateNetworkServiceEntity(
							nil, 							// allocator
							kSCDynamicStoreDomainSetup,		// domain    = "Setup:"
							kSCCompAnyRegex,				// serviceID = "[^/]+" (1 or more non-slash chars)
							kSCEntNetIPv4);					// entity    = "IPv4"
		err = MoreSCError( (void *) dhcpPattern );
	}
	
	// Find all the configured IPv4 entities in the dynamic store.
	
	if (err == noErr) {
		configuredIPv4DynamicKeys = SCDynamicStoreCopyKeyList(storeRef, dhcpPattern);
		err = MoreSCError( (void *) configuredIPv4DynamicKeys );
	}
	
	// Create an array for the output results.
	
	if (err == noErr) {
		result = CFArrayCreateMutable(nil, CFArrayGetCount(configuredIPv4DynamicKeys), &kCFTypeArrayCallBacks);
		if (result == nil) {
			err = coreFoundationUnknownErr;
		}
	}
	
	// Walk through the list of IPv4 Setup entities looking for those with the 
	// ConfigMethod = DHCP property.  For each one you find, append the service ID 
	// to the result list.
	
	if (err == noErr) {
		err = AppendServiceIDForEachDHCPDynamicStoreKey(storeRef, configuredIPv4DynamicKeys, result);
	}
	
	// Clean up.
	
	CFQRelease(dhcpPattern);
	CFQRelease(configuredIPv4DynamicKeys);
	if (err != noErr) {
		CFQRelease(result);
		result = nil;
	}
	*activeDHCP = result;
	CFQRelease(storeRef);
	
	MoreAssertQ( (err == noErr) == (*activeDHCP != nil) );
	
	return err;
}

extern pascal OSStatus MoreSCDHCPRelease(CFStringRef serviceID)
	// See comment in header.
{
	OSStatus 				err;

	// Mark the entity inactive.
		
	err = MoreSCOpen(false, false);	
	if (err == noErr) {
		err = MoreSCSetEntityActive(nil, serviceID, kSCEntNetIPv4, false);
	}
	MoreSCClose(&err, true);

	// Mark the entity active.
	
	if (err == noErr) {	
		err = MoreSCOpen(false, false);
		if (err == noErr) {
			err = MoreSCSetEntityActive(nil, serviceID, kSCEntNetIPv4, true);
	    }
	    MoreSCClose(&err, true);
	}

	return err;
}

/////////////////////////////////////////////////////////////////
#pragma mark ***** ISP APIs

extern pascal OSStatus MoreSCFindSetByUserVisibleNameAndCopyID(CFStringRef userVisibleName, CFStringRef *setID)
	// See comment in header.
{
	OSStatus 	err;
	CFArrayRef 	setIDs;
	
	MoreAssertQ(userVisibleName != nil);
	MoreAssertQ( setID != nil);
	MoreAssertQ(*setID == nil);
	
	setIDs = nil;

	// Get an array of the set IDs, iterate over that array looking for 
	// an element whose user-visible name matches.
	
	err = MoreSCCopySetIDs(&setIDs, nil);
	if (err == noErr) {
		CFIndex setCount;
		CFIndex setIndex;
		
		setCount = CFArrayGetCount(setIDs);
		setIndex = 0;
		while ( (err == noErr) && (setIndex < setCount) && (*setID == nil) ) {
			CFStringRef thisName;
			CFStringRef thisSet;
			
			thisSet = (CFStringRef) CFArrayGetValueAtIndex(setIDs, setIndex);
			
			thisName = nil;
			err = MoreSCCopyUserVisibleNameOfSet(thisSet, &thisName);
			if (err == noErr) {
				if ( CFEqual(userVisibleName, thisName) ) {
					*setID = (CFStringRef) CFRetain(thisSet);
				}
			}
			if (err == noErr && *setID == nil) {
				setIndex += 1;
			}
			
			CFQRelease(thisName);
		}
	}
	
	CFQRelease(setIDs);
	
	return err;
}

static OSStatus CopyDefaultModemPortBSDName(CFStringRef *bsdName)
	// Returns in *bsdName the BSD name of the default modem 
	// port.  It works by getting a list of all of the ports 
	// and then searching that list for the first modem port.
	// MoreSCCreatePortArray returns the ports in a well-specified 
	// order, with the default port of a particular port type 
	// listed first.
{
	OSStatus 	err;
	CFArrayRef 	portArray;

	MoreAssertQ( bsdName != nil);
	MoreAssertQ(*bsdName == nil);
	
	portArray = nil;
	
	err = MoreSCCreatePortArray(&portArray);
	if (err == noErr) {
		CFIndex portCount;
		CFIndex portIndex;
	
		portCount = CFArrayGetCount(portArray);
		for (portIndex = 0; portIndex < portCount; portIndex++) {
			CFStringRef kind;
			
			kind = (CFStringRef) CFDictionaryGetValue( (CFDictionaryRef) CFArrayGetValueAtIndex(portArray, portIndex), kSCPropNetInterfaceHardware );
			if ( CFEqual(kind, kSCEntNetModem) ) {
				*bsdName = (CFStringRef) CFRetain( CFDictionaryGetValue( (CFDictionaryRef) CFArrayGetValueAtIndex(portArray, portIndex), kSCPropNetInterfaceDeviceName) );
				break;
			}
		}
	}
	
	CFQRelease(portArray);

	MoreAssertQ( (err == noErr) == (bsdName != nil) );
	
	return err;
}

static OSStatus SetupEntity(CFStringRef setID, CFStringRef serviceID, CFStringRef protocol, 
							const MoreSCDigest  *digest)
	// Given all of the information required to set up an entity
	// (its set, its service within that set, and its protocol 
	// (ie entity type), and a digest of the value we want), 
	// this routine sets up the entity.
	//
	// digest can be nil, in which case this routine sets 
	// the entity to have a default value.
{
	OSStatus 		err;
	MoreSCDigest 	digestLocal;
	CFDictionaryRef entityDict;

	MoreAssertQ(setID     != nil);
	MoreAssertQ(serviceID != nil);	
	MoreAssertQ(protocol  != nil);
	
	entityDict = nil;

	// If we didn't get a digest, create a default one 
	// (all zeroes).
		
	if (digest == nil) {
		BlockZero(&digestLocal, sizeof(digestLocal));
		digest = &digestLocal;
	}

	// Create an entity dictionary from the digest and then 
	// set the entity value in the preferences to that 
	// dictionary.
	
	err = MoreSCCreateEntity(protocol, digest, &entityDict);
	if (err == noErr) {
		err = MoreSCSetEntity(setID, serviceID, protocol, entityDict);
	}

	CFQRelease(entityDict);
	
	return err;
}

extern pascal OSStatus MoreSCMakeNewDialupSet(
									CFStringRef					bsdName, 
									CFStringRef					userVisibleName, 
									const MoreSCModemDigest *	modemSettings, 
									const MoreSCPPPDigest * 	pppSettings, 
									const MoreSCIPv4Digest *	ipv4Settings,
									const MoreSCDNSDigest *		dnsSettings,
									CFStringRef *				newSetID)
	// See comment in header.
{
	OSStatus 	err;
	CFStringRef portName;
	CFStringRef newSetIDLocal;
	CFArrayRef  serviceIDs;

	MoreAssertQ(userVisibleName != nil);
	MoreAssertQ(pppSettings != nil);
	MoreAssertQ(pppSettings->active);

	portName = nil;
	newSetIDLocal = nil;
	serviceIDs = nil;

	// We open up a connection here to ensure that all of our 
	// changes get committed at the end.
	
	err = MoreSCOpen(false, false);
	
	// Find the appropriate BSD port name.
	
	if (err == noErr) {
		if (bsdName == nil) {
			err = CopyDefaultModemPortBSDName(&portName);
		} else {
			portName = (CFStringRef) CFRetain(bsdName);
		}
	}

	// Create a set and get the list of service IDs.
	
	if (err == noErr) {
		err = MoreSCNewSet(userVisibleName, &newSetIDLocal);
	}
	if (err == noErr) {
		err = MoreSCCopyServiceIDs(newSetIDLocal, &serviceIDs, nil);
	}
	
	if (err == noErr) {
		CFIndex serviceCount;
		CFIndex serviceIndex;
		
		// Loop through every service in the new set.  If the service's 
		// BSD name matches the port we're configuring, overwrite the 
		// service's entities with ones created from our settings.  
		// For non-matching services, just disable the service.
		
		serviceCount = CFArrayGetCount(serviceIDs);
		for (serviceIndex = 0; serviceIndex < serviceCount; serviceIndex++) {
			CFStringRef thisService;
			CFStringRef thisServiceBSDName;
			
			thisServiceBSDName = nil;
			thisService = (CFStringRef) CFArrayGetValueAtIndex(serviceIDs, serviceIndex);
			err = MoreSCCopyBSDNameOfService(newSetIDLocal, thisService, &thisServiceBSDName);
			if (err == noErr) {
				if ( CFEqual(portName, thisServiceBSDName) ) {
					err = SetupEntity(newSetIDLocal, thisService, kSCEntNetPPP, 
									  (MoreSCDigest *) pppSettings);
					if (err == noErr && modemSettings != nil) {
						err = SetupEntity(newSetIDLocal, thisService, kSCEntNetModem, 
										  (MoreSCDigest *) modemSettings);
					}
					if (err == noErr && ipv4Settings != nil) {
						err = SetupEntity(newSetIDLocal, thisService, kSCEntNetIPv4, 
										  (MoreSCDigest *) ipv4Settings);
					}
					if (err == noErr && dnsSettings != nil) {
						err = SetupEntity(newSetIDLocal, thisService, kSCEntNetDNS, 
										  (MoreSCDigest *) dnsSettings);
					}
				} else {
					err = MoreSCSetServiceActive(newSetIDLocal, thisService, false);
				}
			}
			
			CFQRelease(thisServiceBSDName);
			
			if (err != noErr) {
				break;
			}
		}
	}
	if (err != noErr) {
		// On error, delete any partially created set.
		if (newSetIDLocal != nil) {
			(void) MoreSCDeleteSet(newSetIDLocal);
			CFRelease(newSetIDLocal);
			newSetIDLocal = nil;
		}
	}
	MoreSCClose(&err, true);
	
	// Clean up.
	
	CFQRelease(portName);
	CFQRelease(serviceIDs);
	if (newSetID != nil) {
		*newSetID = newSetIDLocal;
	} else {
		CFQRelease(newSetIDLocal);
	}
	
	MoreAssertQ( (err == noErr) == ( (newSetID == nil) || (*newSetID != nil) ) );
	
	return err;
}
