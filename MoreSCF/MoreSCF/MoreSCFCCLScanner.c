/*
	File:		MoreSCFCCLScanner.c

	Contains:	Code to generate list of modem script on Mac OS X.

	Written by:	Quinn

	Copyright:	Copyright (c) 2002 by Apple Computer, Inc., All Rights Reserved.

	Disclaimer:	IMPORTANT:  This Apple software is supplied to you by Apple Computer, Inc.
				("Apple") in consideration of your agreement to the following terms, and your
				use, installation, modification or redistribution of this Apple software
				constitutes acceptance of these terms.  If you do not agree with these terms,
				please do not use, install, modify or redistribute this Apple software.

				In consideration of your agreement to abide by the following terms, and subject
				to these terms, Apple grants you a personal, non-exclusive license, under AppleÕs
				copyrights in this original Apple software (the "Apple Software"), to use,
				reproduce, modify and redistribute the Apple Software, with or without
				modifications, in source and/or binary forms; provided that if you redistribute
				the Apple Software in its entirety and without modifications, you must retain
				this notice and the following text and disclaimers in all such redistributions of
				the Apple Software.  Neither the name, trademarks, service marks or logos of
				Apple Computer, Inc. may be used to endorse or promote products derived from the
				Apple Software without specific prior written permission from Apple.  Except as
				expressly stated in this notice, no other rights or licenses, express or implied,
				are granted by Apple herein, including but not limited to any patent rights that
				may be infringed by your derivative works or by other works in which the Apple
				Software may be incorporated.

				The Apple Software is provided by Apple on an "AS IS" basis.  APPLE MAKES NO
				WARRANTIES, EXPRESS OR IMPLIED, INCLUDING WITHOUT LIMITATION THE IMPLIED
				WARRANTIES OF NON-INFRINGEMENT, MERCHANTABILITY AND FITNESS FOR A PARTICULAR
				PURPOSE, REGARDING THE APPLE SOFTWARE OR ITS USE AND OPERATION ALONE OR IN
				COMBINATION WITH YOUR PRODUCTS.

				IN NO EVENT SHALL APPLE BE LIABLE FOR ANY SPECIAL, INDIRECT, INCIDENTAL OR
				CONSEQUENTIAL DAMAGES (INCLUDING, BUT NOT LIMITED TO, PROCUREMENT OF SUBSTITUTE
				GOODS OR SERVICES; LOSS OF USE, DATA, OR PROFITS; OR BUSINESS INTERRUPTION)
				ARISING IN ANY WAY OUT OF THE USE, REPRODUCTION, MODIFICATION AND/OR DISTRIBUTION
				OF THE APPLE SOFTWARE, HOWEVER CAUSED AND WHETHER UNDER THEORY OF CONTRACT, TORT
				(INCLUDING NEGLIGENCE), STRICT LIABILITY OR OTHERWISE, EVEN IF APPLE HAS BEEN
				ADVISED OF THE POSSIBILITY OF SUCH DAMAGE.

	Change History (most recent first):

$Log: MoreSCFCCLScanner.c,v $
Revision 1.2  2002/01/22 06:15:53  eskimo1
C++ compatibility.

Revision 1.1  2002/01/16 22:52:24  eskimo1
First checked in.


*/

/////////////////////////////////////////////////////////////////

// MoreIsBetter Setup

#include "MoreSetup.h"

// System Interfaces

// MIB prototypes

#include "MoreCFQ.h"

// Our prototypes

#include "MoreSCFCCLScanner.h"

/////////////////////////////////////////////////////////////////

enum {
	kFolderItemsPerBulkCall = 50
};

static OSStatus AddCCLsInFolderToArray(const FSRef *folderRef, CFMutableArrayRef result)
	// Iterates through the contents of the folder specified by folderRef, 
	// adding the name of each CCL file (ie any file that's visible) to 
	// the result array.
{
	OSStatus			err;
	OSStatus			junk;
	FSRef *				scriptRefs;
	HFSUniStr255 *		scriptNames;
	FSIterator 			iter;
	ItemCount  			actCount;
	ItemCount			thisItemIndex;
	Boolean    			done;
	LSItemInfoRecord 	itemInfo;

	iter = nil;
	scriptRefs = nil;
	scriptNames = nil;
	
	// Allocate buffers for the FSRefs and long Unicode names.  Given that 
	// we're processing 50 files at a time, these buffers are way too big 
	// to store on the stack (25 KB for scriptNames alone).
	
	scriptRefs  = (FSRef *) malloc( kFolderItemsPerBulkCall * sizeof(FSRef) );
	scriptNames = (HFSUniStr255 *) malloc( kFolderItemsPerBulkCall * sizeof(HFSUniStr255) );
	err = noErr;
	if (scriptRefs == nil || scriptNames == nil) {
		err = memFullErr;
	}
	
	// Create the iterator.
	
	if (err == noErr) {
		err = FSOpenIterator(folderRef, kFSIterateFlat, &iter);
	}
	
	// Iterate over the contents of the directory.  For each item found 
	// we check whether it's a visible plain file and, if it is, add its 
	// name to the array.
	
	if (err == noErr) {
		done = false;
		do {
			err = FSGetCatalogInfoBulk(iter, kFolderItemsPerBulkCall, &actCount, nil, kFSCatInfoNone, nil, 
									   scriptRefs, nil, scriptNames);
			if (err == errFSNoMoreItems) {
				// We ran off the end of the directory.  Record that we're
				// done, but set err to noErr so that we process any partial
				// results.
				done = true;
				err = noErr;
			}
			if (err == noErr) {
				for (thisItemIndex = 0; thisItemIndex < actCount; thisItemIndex++) {

					// Call Launch Services to check that the item is a visible file.

					err = LSCopyItemInfoForRef(&scriptRefs[thisItemIndex], kLSRequestBasicFlagsOnly, &itemInfo);
					if (        (err == noErr) 
							&&  (itemInfo.flags & kLSItemInfoIsPlainFile) 
							&& !(itemInfo.flags & kLSItemInfoIsInvisible) ) {
						CFStringRef thisItemName;
						
						thisItemName = CFStringCreateWithCharacters(nil, scriptNames[thisItemIndex].unicode, scriptNames[thisItemIndex].length);
						if (thisItemName == nil) {
							err = coreFoundationUnknownErr;
						}
						if (err == noErr) {
							CFArrayAppendValue(result, thisItemName);
						}
						CFQRelease(thisItemName);
					}
					if (err != noErr) {
						break;
					}
				}						
			}
		} while (err == noErr && !done);
	}

	// Clean up.
	
	if (iter != nil) {
		junk = FSCloseIterator(iter);
		MoreAssertQ(junk == noErr);
	}
	if (scriptRefs != nil) {
		free(scriptRefs);
	}
	if (scriptNames != nil) {
		free(scriptNames);
	}

	return err;
}

enum {
	kMyStringCompareOptions = kCFCompareCaseInsensitive | kCFCompareLocalized | kCFCompareNumerically
};

extern pascal OSStatus MoreSCCreateCCLArray(CFArrayRef *result, CFIndex *indexOfDefaultCCL)
	// See comment in header.
{
	OSStatus 			err;
	CFMutableArrayRef	localResult;
	UInt32   			domainIndex;
	FSRef				folderRef;
	static const SInt16 kFolderDomains[] = {kUserDomain, kNetworkDomain, kLocalDomain, kSystemDomain, 0};
	
	MoreAssertQ( result != nil);
	MoreAssertQ(*result == nil);
	
	// Create an array containing the names of the CCLs from the Modem Scripts 
	// folder in each domain.

	localResult = nil;
		
	err = CFQArrayCreateMutable(&localResult);
	if (err == noErr) {
		domainIndex = 0;
		do {
			err = FSFindFolder(kFolderDomains[domainIndex], kModemScriptsFolderType, false, &folderRef);
			if (err != noErr) {
				// If we can't find the folder in this domain, just ignore the domain.
				err = noErr;
			} else {
				// If we found the folder, add each CCL in it to the array.
				err = AddCCLsInFolderToArray(&folderRef, localResult);
			}
			domainIndex += 1;
		} while (err == noErr && kFolderDomains[domainIndex] != 0);
	}
	
	// Sort the resulting array and delete any duplicates.
	
	if (err == noErr) {
		CFIndex cursor;
		
		CFArraySortValues(localResult, CFRangeMake(0, CFArrayGetCount(localResult)), 
						  (CFComparatorFunction) CFStringCompare, (void *) kMyStringCompareOptions);
		
		cursor = 1;
		while (cursor < CFArrayGetCount(localResult)) {
			if ( CFEqual(CFArrayGetValueAtIndex(localResult, cursor), CFArrayGetValueAtIndex(localResult, cursor - 1)) ) {
				CFArrayRemoveValueAtIndex(localResult, cursor);
			} else {
				cursor += 1;
			}
		}
	}
	
	// Find the index of the default CCL (or use the first CCL if the default 
	// isn't found).  The array is already sorted for user presentation, so 
	// we can use CFArrayBSearchValues rather than searching by hand.  This 
	// might even be a relevant speed increase because the number of CCLs can 
	// range into the hundreds.
	
	if (err == noErr && indexOfDefaultCCL != nil) {
		CFStringRef defaultCCLName;
		CFIndex     itemIndex;
		
		defaultCCLName = CFSTR("Apple Internal 56K Modem (v.90)");

		itemIndex = CFArrayBSearchValues(localResult, CFRangeMake(0, CFArrayGetCount(localResult)), 
											defaultCCLName, 
											(CFComparatorFunction) CFStringCompare, (void *) kMyStringCompareOptions);
		// itemIndex is either:
		//
		// o pointing directly at the correct element, if an exact match is found, or 
		//
		// o if no exact match is found, pointing after the element that's immediately 
		//   less than defaultCCLName
		//
		// So, to confirm that we have the default script we check that the item is in 
		// bounds and that its value matches defaultCCLName.  If either of these 
		// checks fails, we return the index of the first CCL.
		
		if ( (itemIndex < CFArrayGetCount(localResult)) 
				&& (CFStringCompare(defaultCCLName, 
									(CFStringRef) CFArrayGetValueAtIndex(localResult, itemIndex), 
									kMyStringCompareOptions) == kCFCompareEqualTo)) {
			*indexOfDefaultCCL = itemIndex;
		} else {
			*indexOfDefaultCCL = 0;
		}
	}

	// Clean up.
	
	if (err != noErr) {
		CFQRelease(localResult);
		localResult = nil;
	}
	*result = localResult;
	
	MoreAssertQ( (err == noErr) == (*result != nil) );
	MoreAssertQ( 	(err != noErr) 							// either we got an error
				 || (indexOfDefaultCCL == nil) 				// or the user didn't ask for the default CCL
				 || (CFArrayGetCount(*result) == 0) 		// or there are no CCLs
				 || (*indexOfDefaultCCL >= 0 && *indexOfDefaultCCL < CFArrayGetCount(*result)) );
				 											// or the default CCL we're returning is in bounds

	return err;
}
