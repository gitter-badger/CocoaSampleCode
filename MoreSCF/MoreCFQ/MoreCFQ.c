/*
	File:		MoreCFQ.c

	Contains:	Core Foundation utility Routines.

	Written by:	Quinn

	Copyright:	Copyright (c) 2001 by Apple Computer, Inc., All Rights Reserved.

	Disclaimer:	IMPORTANT:  This Apple software is supplied to you by Apple Computer, Inc.
				("Apple") in consideration of your agreement to the following terms, and your
				use, installation, modification or redistribution of this Apple software
				constitutes acceptance of these terms.  If you do not agree with these terms,
				please do not use, install, modify or redistribute this Apple software.

				In consideration of your agreement to abide by the following terms, and subject
				to these terms, Apple grants you a personal, non-exclusive license, under AppleÕs
				copyrights in this original Apple software (the "Apple Software"), to use,
				reproduce, modify and redistribute the Apple Software, with or without
				modifications, in source and/or binary forms; provided that if you redistribute
				the Apple Software in its entirety and without modifications, you must retain
				this notice and the following text and disclaimers in all such redistributions of
				the Apple Software.  Neither the name, trademarks, service marks or logos of
				Apple Computer, Inc. may be used to endorse or promote products derived from the
				Apple Software without specific prior written permission from Apple.  Except as
				expressly stated in this notice, no other rights or licenses, express or implied,
				are granted by Apple herein, including but not limited to any patent rights that
				may be infringed by your derivative works or by other works in which the Apple
				Software may be incorporated.

				The Apple Software is provided by Apple on an "AS IS" basis.  APPLE MAKES NO
				WARRANTIES, EXPRESS OR IMPLIED, INCLUDING WITHOUT LIMITATION THE IMPLIED
				WARRANTIES OF NON-INFRINGEMENT, MERCHANTABILITY AND FITNESS FOR A PARTICULAR
				PURPOSE, REGARDING THE APPLE SOFTWARE OR ITS USE AND OPERATION ALONE OR IN
				COMBINATION WITH YOUR PRODUCTS.

				IN NO EVENT SHALL APPLE BE LIABLE FOR ANY SPECIAL, INDIRECT, INCIDENTAL OR
				CONSEQUENTIAL DAMAGES (INCLUDING, BUT NOT LIMITED TO, PROCUREMENT OF SUBSTITUTE
				GOODS OR SERVICES; LOSS OF USE, DATA, OR PROFITS; OR BUSINESS INTERRUPTION)
				ARISING IN ANY WAY OUT OF THE USE, REPRODUCTION, MODIFICATION AND/OR DISTRIBUTION
				OF THE APPLE SOFTWARE, HOWEVER CAUSED AND WHETHER UNDER THEORY OF CONTRACT, TORT
				(INCLUDING NEGLIGENCE), STRICT LIABILITY OR OTHERWISE, EVEN IF APPLE HAS BEEN
				ADVISED OF THE POSSIBILITY OF SUCH DAMAGE.

	Change History (most recent first):

$Log: MoreCFQ.c,v $
Revision 1.2  2002/01/22 06:14:19  eskimo1
Change CFQDictionaryAddNumber to CFQDictionarySetNumber.

Revision 1.1  2002/01/16 22:51:31  eskimo1
First checked in.


*/

/////////////////////////////////////////////////////////////////

// MoreIsBetter Setup

#include "MoreSetup.h"

// Our prototypes

#include "MoreCFQ.h"

/////////////////////////////////////////////////////////////////
#pragma mark ***** Trivial Utilities

extern pascal CFTypeRef CFQRetain(CFTypeRef cf)
	// See comment in header.
{
	if (cf != nil) {
		(void) CFRetain(cf);
	}
	return cf;
}

extern pascal void CFQRelease(CFTypeRef cf)
	// See comment in header.
{
	if (cf != nil) {
		CFRelease(cf);
	}
}

extern pascal OSStatus CFQDictionaryCreateMutable(CFMutableDictionaryRef *result)
	// See comment in header.
{
	OSStatus err;
	
	MoreAssertQ( result != nil);
	MoreAssertQ(*result == nil);

	err = noErr;
	*result = CFDictionaryCreateMutable(nil, 0, &kCFTypeDictionaryKeyCallBacks, &kCFTypeDictionaryValueCallBacks);
	if (*result == nil) {
		err = coreFoundationUnknownErr;
	}
	MoreAssertQ( (err == noErr) == (*result != nil) );
	return err;
}

extern pascal OSStatus CFQArrayCreateMutable(CFMutableArrayRef *result)
	// See comment in header.
{
	OSStatus err;
	
	MoreAssertQ( result != nil);
	MoreAssertQ(*result == nil);

	err = noErr;
	*result = CFArrayCreateMutable(nil, 0, &kCFTypeArrayCallBacks);
	if (*result == nil) {
		err = coreFoundationUnknownErr;
	}
	MoreAssertQ( (err == noErr) == (*result != nil) );
	return err;
}

extern pascal OSStatus CFQArrayCreateWithDictionaryKeys(CFDictionaryRef dict, CFArrayRef *result)
	// See comment in header.
{
	OSStatus 	err;
	CFTypeRef *	keys;
	
	MoreAssertQ( dict   != nil);
	MoreAssertQ( result != nil);
	MoreAssertQ(*result == nil);

	// Allocate a buffer for the keys, get the keys into the buffer, and 
	// create the array from that buffer.
		
	err = noErr;
	keys = (CFTypeRef *) malloc( CFDictionaryGetCount(dict) * sizeof(CFTypeRef) );
	if (keys == nil) {
		err = memFullErr;
	}
	if (err == noErr) {
		CFDictionaryGetKeysAndValues(dict, (const void **) keys, nil);
		
		*result = CFArrayCreate(nil, keys, CFDictionaryGetCount(dict), &kCFTypeArrayCallBacks);
		if (*result == nil) {
			err = coreFoundationUnknownErr;
		}
	}

	// Clean up.
		
	if (keys != nil) {
		free(keys);
	}
	
	MoreAssertQ( (err == noErr) == (*result != nil) );
	MoreAssertQ( (*result == nil) || (CFDictionaryGetCount(dict) == CFArrayGetCount(*result)) );
	
	return err;
}

extern pascal OSStatus CFQArrayCreateWithDictionaryValues(CFDictionaryRef dict, CFArrayRef *result)
	// See comment in header.
{
	OSStatus 	err;
	CFTypeRef *	values;
	
	MoreAssertQ( dict   != nil);
	MoreAssertQ( result != nil);
	MoreAssertQ(*result == nil);
	
	// Allocate a buffer for the values, get the values into the buffer, and 
	// create the array from that buffer.

	err = noErr;
	values = (CFTypeRef *) malloc( CFDictionaryGetCount(dict) * sizeof(CFTypeRef) );
	if (values == nil) {
		err = memFullErr;
	}
	if (err == noErr) {
		CFDictionaryGetKeysAndValues(dict, nil, (const void **) values);
		
		*result = CFArrayCreate(nil, values, CFDictionaryGetCount(dict), &kCFTypeArrayCallBacks);
		if (*result == nil) {
			err = coreFoundationUnknownErr;
		}
	}
	
	// Clean up.
	
	if (values != nil) {
		free(values);
	}
	
	MoreAssertQ( (err == noErr) == (*result != nil) );
	MoreAssertQ( (*result == nil) || (CFDictionaryGetCount(dict) == CFArrayGetCount(*result)) );
	
	return err;
}

extern pascal OSStatus CFQDictionaryCreateWithArrayOfKeysAndValues(CFArrayRef keys, 
																   CFArrayRef values, 
																   CFDictionaryRef *result)
	// See comment in header.
{
	OSStatus    err;
	CFIndex 	count;
	CFTypeRef * keysBuffer;
	CFTypeRef * valuesBuffer;
	
	MoreAssertQ(keys != nil);
	MoreAssertQ(values != nil);
	MoreAssertQ( CFArrayGetCount(keys) == CFArrayGetCount(values) );
	MoreAssertQ( result != nil);
	MoreAssertQ(*result == nil);
	
	keysBuffer   = nil;
	valuesBuffer = nil;

	// Check that the arrays are of a like size.
		
	err = noErr;
	count = CFArrayGetCount(keys);
	if ( count != CFArrayGetCount(values) ) {
		err = paramErr;
	}
	
	// Allocate a buffer for both keys and values.
	
	if (err == noErr) {
		keysBuffer   = (CFTypeRef *) malloc( sizeof(CFTypeRef) * count );
		valuesBuffer = (CFTypeRef *) malloc( sizeof(CFTypeRef) * count );
		if (keysBuffer == nil || valuesBuffer == nil) {
			err = memFullErr;
		}
	}
	
	// Get the keys and values into their buffers, and create a 
	// dictionary based on the buffer.
	
	if (err == noErr) {
		CFArrayGetValues(keys,   CFRangeMake(0, count), keysBuffer);
		CFArrayGetValues(values, CFRangeMake(0, count), valuesBuffer);
		
		*result = CFDictionaryCreate(nil, keysBuffer, valuesBuffer, count, &kCFTypeDictionaryKeyCallBacks, &kCFTypeDictionaryValueCallBacks);
		if (*result == nil) {
			err = coreFoundationUnknownErr;
		}
	}
	
	// Clean up.
	
	if (keysBuffer != nil) {
		free(keysBuffer);
	}
	if (valuesBuffer != nil) {
		free(valuesBuffer);
	}
	
	return err;
}

extern pascal OSStatus CFQDictionarySetNumber(CFMutableDictionaryRef dict, const void *key, long value)
	// See comment in header.
{
	OSStatus    err;
	CFNumberRef valueNum;

	// Create a CFNumber and add it to the dictionary.
		
	err = noErr;
	valueNum = CFNumberCreate(nil, kCFNumberLongType, &value);
	if (valueNum == nil) {
		err = coreFoundationUnknownErr;
	}
	if (err == noErr) {
		CFDictionarySetValue(dict, key, valueNum);
	}
	CFQRelease(valueNum);
	
	return err;
}

/////////////////////////////////////////////////////////////////
#pragma mark ***** Dictionary Path Routines

extern pascal OSStatus CFQDictionaryGetValueAtPath(CFDictionaryRef dict, 
												   const void *path[], CFIndex pathElementCount, 
												   const void **result)
	// See comment in header.
{
	OSStatus 		err;
	CFDictionaryRef parent;
	CFIndex 		thisElement;
	const void *	child;

	MoreAssertQ( dict   != nil);
	MoreAssertQ( path   != nil);
	MoreAssertQ( pathElementCount > 0 );		// 0 length paths aren't allowed
	MoreAssertQ( result != nil);
	MoreAssertQ(*result == nil);

	// This code hasn't been tested yet.
	MoreAssertQ(false);
	
	// Some subtleties in the following loop.
	//
	// o It's possible for dictionaries to contain nil values, so we use 
	//   CFDictionaryGetValueIfPresent to test for the presence of the 
	//   child rather than CFDictionaryGetValue.
	//
	// o We use CFDictionaryGetValueIfPresent in place of the combination of
	//   CFDictionaryContainsKey and CFDictionaryGetValue because it does 
	//   both operations in one hit.
	// 
	// o Loop terminates in one of three ways:
	//     i) a path element isn't found (kCFQKeyNotFoundErr)
	//    ii) we find the last path element
	//   iii) we proceed to the next path element but the child we 
	//        found isn't valid (kCFQDataErr)
	//
	// o There are no releases or retains in this loop because all values are 
	//    got with "Get" operations.

	err = noErr;		
	thisElement = 0;
	parent = dict;

	while (true) {
		if ( ! CFDictionaryGetValueIfPresent(parent, path[thisElement], &child) ) {
			err = kCFQKeyNotFoundErr;
			break;
		}
	
		if (thisElement == (pathElementCount - 1)) {
			break;
		}
		
		if ( (child == nil) || (CFGetTypeID(child) != CFDictionaryGetTypeID()) ) {
			err = kCFQDataErr;
			break;
		}

		parent = (CFDictionaryRef) child;
		thisElement += 1;
	}
	
	if (err == noErr) {
		*result = child;
	}
	
	MoreAssertQ( (err == noErr) == (*result != nil) );
	
	return err;
}

static OSStatus PathArrayHelper(CFArrayRef path, CFTypeRef **pathElements)
	// pathElements is a pointer to an array of CFTypeRefs. 
	// On return, *pathElements is set to a newly allocated 
	// array which you must free using "free".
{
	OSStatus err;
	CFIndex  pathElementCount;

	MoreAssertQ(path != nil);
	MoreAssertQ(pathElements != nil);
	// We don't assert that *pathElements is nil because part of 
	// our semantics is that we always set it to nil.

	pathElementCount = CFArrayGetCount(path);
	MoreAssertQ(pathElementCount > 0);
	
	err = noErr;
	*pathElements = (CFTypeRef *) malloc(sizeof(CFTypeRef) * pathElementCount);
	if (*pathElements == nil) {
		err = memFullErr;
	}
	if (err == noErr) {
		CFArrayGetValues(path, CFRangeMake(0, pathElementCount), *pathElements);
	}
	
	MoreAssertQ( (err == noErr) == (*pathElements != nil) );
	
	return err;
}

extern pascal OSStatus CFQDictionaryGetValueAtPathArray(CFDictionaryRef dict, 
												   CFArrayRef path, 
												   const void **result)
	// See comment in header.
{
	OSStatus 	err;
	CFTypeRef * pathElements;
	
	MoreAssertQ( dict   != nil);
	MoreAssertQ( path   != nil);
	MoreAssertQ( result != nil);
	MoreAssertQ(*result == nil);

	err = PathArrayHelper(path, &pathElements);
	if (err == noErr) {
		err = CFQDictionaryGetValueAtPath(dict, pathElements, CFArrayGetCount(path), result);
	}
	if (pathElements != nil) {
		free(pathElements);
	}

	MoreAssertQ( (err == noErr) == (*result != nil) );

	return err;
}

static OSStatus CFQMutableDictionaryGetParentForPath(CFMutableDictionaryRef dict,
											   const void *path[], CFIndex pathElementCount, 
											   CFMutableDictionaryRef *result)
{
	OSStatus 				err;
	CFIndex 				thisElement;
	CFMutableDictionaryRef 	parent;
	CFDictionaryRef 		child;
	
	MoreAssertQ( dict   != nil);
	MoreAssertQ( path   != nil);
	MoreAssertQ( pathElementCount > 0 );		// 0 length paths aren't allowed
	MoreAssertQ( result != nil);

	// Some subtleties in the following loop.
	//
	// o It's possible for dictionaries to contain nil values, so we use 
	//   CFDictionaryGetValueIfPresent to test for the presence of the 
	//   child rather than CFDictionaryGetValue.
	//
	// o We use CFDictionaryGetValueIfPresent in place of the combination of
	//   CFDictionaryContainsKey and CFDictionaryGetValue because it does 
	//   both operations in one hit.
	// 
	// o Loop terminates in one of three ways:
	//     i) we reach the last path element
	//    ii) a path element isn't found (kCFQKeyNotFoundErr)
	//   iii) we proceed to the next path element but the child we 
	//        found isn't valid (kCFQDataErr)
	//    iv) we get an error when creating a mutable dictionary
	//
	// o Memory tracking is very tricky.  Specifically, we have to be 
	//   very careful with the mutableChild variable.  We create this 
	//   each time we progress through a dictionary in the loop.  Each 
	//   time we create it we then immediately add it to the parent 
	//   dictionary, thus ensuring a continued reference count after 
	//   we release our reference count.

	err = noErr;
	thisElement = 0;
	parent = dict;

	while (true) {
		if (thisElement == (pathElementCount - 1)) {
			break;
		}

		if ( ! CFDictionaryGetValueIfPresent(parent, path[thisElement], (const void **) &child) ) {
			err = kCFQKeyNotFoundErr;
			break;
		}
	
		if ( (child == nil) || (CFGetTypeID(child) != CFDictionaryGetTypeID()) ) {
			err = kCFQDataErr;
			break;
		}
		
		{
			CFMutableDictionaryRef mutableChild;
			
			mutableChild = CFDictionaryCreateMutableCopy(nil, 0, child);
			if (mutableChild == nil) {
				err = coreFoundationUnknownErr;
			}
			if (err == noErr) {
				CFDictionarySetValue(parent, path[thisElement], mutableChild);
				
				MoreAssertQ( CFGetRetainCount(mutableChild) >= 2 );
				
				parent = mutableChild;
				thisElement += 1;
			}
			
			CFQRelease(mutableChild);
		}
		if (err != noErr) {
			break;
		}
	}
	if (err == noErr) {
		*result = parent;
	}
	
	MoreAssertQ( (err == noErr) == (*result != nil) );
	
	return err;
}

extern pascal OSStatus CFQDictionarySetValueAtPath(CFMutableDictionaryRef dict, 
												   const void *path[], CFIndex pathElementCount, 
												   const void *value)
	// See comment in header.
{
	OSStatus 				err;
	CFMutableDictionaryRef 	parent;
	
	MoreAssertQ( dict   != nil);
	MoreAssertQ( path   != nil);
	MoreAssertQ( pathElementCount > 0 );		// 0 length paths aren't allowed

	err = CFQMutableDictionaryGetParentForPath(dict, path, pathElementCount, &parent);
	if (err == noErr) {
		CFDictionarySetValue(parent, path[pathElementCount - 1], value);
	}

	return err;	
}

extern pascal OSStatus CFQDictionarySetValueAtPathArray(CFMutableDictionaryRef dict, 
												   CFArrayRef path, 
												   const void *value)
	// See comment in header.
{
	OSStatus 	err;
	CFTypeRef *	pathElements;
	
	MoreAssertQ( dict   != nil);
	MoreAssertQ( path   != nil);

	err = PathArrayHelper(path, &pathElements);
	if (err == noErr) {
		err = CFQDictionarySetValueAtPath(dict, pathElements, CFArrayGetCount(path), value);
	}
	if (pathElements != nil) {
		free(pathElements);
	}

	return err;
}

extern pascal OSStatus CFQDictionaryRemoveValueAtPath(CFMutableDictionaryRef dict, 
												   const void *path[], CFIndex pathElementCount)
	// See comment in header.
{
	OSStatus 				err;
	CFMutableDictionaryRef 	parent;
	
	MoreAssertQ( dict   != nil);
	MoreAssertQ( path   != nil);
	MoreAssertQ( pathElementCount > 0 );		// 0 length paths aren't allowed

	err = CFQMutableDictionaryGetParentForPath(dict, path, pathElementCount, &parent);
	if ( ! CFDictionaryContainsKey(parent, path[pathElementCount - 1]) ) {
		err = kCFQKeyNotFoundErr;
	}
	if (err == noErr) {
		CFDictionaryRemoveValue(parent, path[pathElementCount - 1]);
	}

	return err;	
}

extern pascal OSStatus CFQDictionaryRemoveValueAtPathArray(CFMutableDictionaryRef dict, 
												   CFArrayRef path)
	// See comment in header.
{
	OSStatus 	err;
	CFTypeRef *	pathElements;
	
	MoreAssertQ( dict   != nil);
	MoreAssertQ( path   != nil);

	err = PathArrayHelper(path, &pathElements);
	if (err == noErr) {
		err = CFQDictionaryRemoveValueAtPath(dict, pathElements, CFArrayGetCount(path));
	}
	if (pathElements != nil) {
		free(pathElements);
	}

	return err;
}

/////////////////////////////////////////////////////////////////
#pragma mark ***** Property List Traversal Routines

extern pascal void CFQPropertyListDeepApplyFunction(CFPropertyListRef propList, 
													CFQPropertyListDeepApplierFunction func,
													void *context)
	// See comment in header.
{
	MoreAssertQ(propList != nil);
	MoreAssertQ(func     != nil);
	
	// Call "func" for this node.
	
	func(propList, context);
	
	// If this node is a dictionary or an array, call func for 
	// each element.
	
	if ( CFGetTypeID(propList) == CFDictionaryGetTypeID() ) {
		CFIndex count;
		CFIndex index;
		const void **keys;
		
		count = CFDictionaryGetCount( (CFDictionaryRef) propList);
		
		keys = (const void **) malloc( count * sizeof(const void *));
		if (keys != nil) {
			CFDictionaryGetKeysAndValues( (CFDictionaryRef) propList, keys, nil);
			
			for (index = 0; index < count; index++) {
				CFQPropertyListDeepApplyFunction(CFDictionaryGetValue( (CFDictionaryRef) propList, keys[index]), func, context);
			}
			free(keys);
		}
	} else if ( CFGetTypeID(propList) == CFArrayGetTypeID() ) {
		CFIndex count;
		long    index;
		
		count = CFArrayGetCount( (CFArrayRef) propList);
		for (index = 0; index < count; index++) {
			CFQPropertyListDeepApplyFunction(CFArrayGetValueAtIndex( (CFArrayRef) propList, index), func, context);
		}
	}
}

extern pascal Boolean CFQPropertyListIsLeaf(CFTypeRef node)
	// See comment in header.
{
	return ! (	   (CFGetTypeID(node) == CFDictionaryGetTypeID())
				|| (CFGetTypeID(node) == CFArrayGetTypeID())      );
}

extern pascal void CFQPropertyListShallowApplyFunction(CFPropertyListRef propList, 
													   CFQPropertyListShallowApplierFunction func,
													   void *context)
	// See comment in header.
{
	MoreAssertQ(propList != nil);
	MoreAssertQ(func     != nil);

	// If this node is a dictionary, call "func" for each element.
	//
	// If this node is an array, call "func" for each element and 
	// pass a CFNumber of the element's array index to its "key" 
	// parameter.
	
	if ( CFGetTypeID(propList) == CFDictionaryGetTypeID() ) {
		CFIndex count;
		CFIndex index;
		const void **keys;
		
		count = CFDictionaryGetCount( (CFDictionaryRef) propList);
		
		keys = (const void **) malloc( count * sizeof(const void *));
		if (keys != nil) {
			CFDictionaryGetKeysAndValues( (CFDictionaryRef) propList, keys, nil);
			
			for (index = 0; index < count; index++) {
				func(keys[index], CFDictionaryGetValue( (CFDictionaryRef) propList, keys[index]), context);
			}
			free(keys);
		}
	} else if ( CFGetTypeID(propList) == CFArrayGetTypeID() ) {
		CFIndex count;
		CFIndex index;
		
		count = CFArrayGetCount( (CFArrayRef) propList);
		for (index = 0; index < count; index++) {
			CFNumberRef key;
			
			key = CFNumberCreate(nil, kCFNumberLongType, &index);
			if (key != nil) {
				func(key, CFArrayGetValueAtIndex( (CFArrayRef) propList, index), context);
				CFRelease(key);
			}
		}
	} else {
		MoreAssertQ(false);
	}
}
